/**
  ******************************************************************************
  * @file           : i2c_oled.c
  * @brief          : SSD1306 OLED 128x64 I2C驱动 + 12x24 7段数字字库
  ******************************************************************************
  */
#include "i2c_oled.h"

static const uint8_t Font6x8[][6] = {
    {0x00,0x00,0x00,0x00,0x00,0x00}, {0x00,0x00,0x5F,0x00,0x00,0x00},
    {0x00,0x07,0x00,0x07,0x00,0x00}, {0x14,0x7F,0x14,0x7F,0x14,0x00},
    {0x24,0x2A,0x7F,0x2A,0x12,0x00}, {0x23,0x13,0x08,0x64,0x62,0x00},
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    {0x02,0x01,0x02,0x04,0x02,0x00},
};

/*
 * 12x24 数字字库 — 7段式, 以0为模板统一壁厚/圆角/高度
 *
 * 基准(0): L={C0,FF,03}+{F0,FF,0F} R={F0,FF,0F}+{C0,FF,03}
 *          T=col1~10 b0: C0/F0/38/18/18/18/18/38/F0/C0
 *          B=col1~10 b2: 03/0F/1C/18/18/18/18/1C/0F/03
 *          M=col3~8 b1: 0x18 (row11-12)
 *  上半竖 Ur/Ul = 壁b0 + b1=0x0F(row8-11)      到中横
 *  下半竖 Dr/Dl = b1=0xF0(row12-15)内/0xE0外 + 壁b2  从中横起
 */
static const uint8_t Font12x24[11][36] = 
{
    // 索引 0 : 数字 0
    {
        0x00,0x00,0x00, 0xC0,0xFF,0x03, 0xF0,0xFF,0x0F, 0x38,0x00,0x1C,
        0x18,0x00,0x18, 0x18,0x00,0x18, 0x18,0x00,0x18, 0x18,0x00,0x18,
        0x38,0x00,0x1C, 0xF0,0xFF,0x0F, 0xC0,0xFF,0x03, 0x00,0x00,0x00
    },
    // 索引 1 : 数字 1
    {
        0x00,0x00,0x00, 0x00,0x00,0x00, 0x00,0x00,0x00, 0x80,0x00,0x18,
        0xC0,0x00,0x18, 0xE0,0xFF,0x1F, 0xF8,0xFF,0x1F, 0x00,0x00,0x18,
        0x00,0x00,0x18, 0x00,0x00,0x00, 0x00,0x00,0x00, 0x00,0x00,0x00
    },
    // 索引 2 : 数字 2
    {
        0x00,0x00,0x00, 0xC0,0xF0,0x03, 0xF0,0xF0,0x0F, 0x38,0x18,0x1C,
        0x18,0x18,0x18, 0x18,0x18,0x18, 0x18,0x18,0x18, 0x18,0x18,0x18,
        0x38,0x18,0x1C, 0xF0,0x0F,0x0F, 0xC0,0x0F,0x03, 0x00,0x00,0x00
    },
    // 索引 3 : 数字 3
    {
        0x00,0x00,0x00, 0xC0,0x00,0x03, 0xF0,0x00,0x0F, 0x38,0x18,0x1C,
        0x18,0x18,0x18, 0x18,0x18,0x18, 0x18,0x18,0x18, 0x18,0x18,0x18,
        0x38,0x18,0x1C, 0xF0,0xFF,0x0F, 0xC0,0xFF,0x03, 0x00,0x00,0x00
    },
    // 索引 4 : 数字 4
    {
        0x00,0x00,0x00, 0xC0,0x0F,0x00, 0xF0,0x0F,0x00, 0x00,0x18,0x00,
        0x00,0x18,0x00, 0x00,0x18,0x00, 0x00,0x18,0x00, 0x00,0x18,0x00,
        0x00,0x18,0x00, 0xF0,0xFF,0x0F, 0xC0,0xFF,0x03, 0x00,0x00,0x00
    },
    // 索引 5 : 数字 5
    {
        0x00,0x00,0x00, 0xC0,0x0F,0x03, 0xF0,0x0F,0x0F, 0x38,0x18,0x1C,
        0x18,0x18,0x18, 0x18,0x18,0x18, 0x18,0x18,0x18, 0x18,0x18,0x18,
        0x38,0x18,0x1C, 0xF0,0xF0,0x0F, 0xC0,0xE0,0x03, 0x00,0x00,0x00
    },
    // 索引 6 : 数字 6
    {
        0x00,0x00,0x00, 0xC0,0xFF,0x03, 0xF0,0xFF,0x0F, 0x38,0x18,0x1C,
        0x18,0x18,0x18, 0x18,0x18,0x18, 0x18,0x18,0x18, 0x18,0x18,0x18,
        0x38,0x18,0x1C, 0xF0,0xF0,0x0F, 0xC0,0xE0,0x03, 0x00,0x00,0x00
    },
    // 索引 7 : 数字 7
    {
        0x00,0x00,0x00, 0x18,0x00,0x00, 0x18,0x00,0x00, 0x18,0x00,0x00,
        0x18,0x00,0x00, 0x18,0x00,0x00, 0x18,0x00,0x00, 0x18,0x00,0x00,
        0x18,0x00,0x00, 0xF0,0xFF,0x0F, 0xC0,0xFF,0x03, 0x00,0x00,0x00
    },
    // 索引 8 : 数字 8
    {
        0x00,0x00,0x00, 0xC0,0xFF,0x03, 0xF0,0xFF,0x0F, 0x38,0x18,0x1C,
        0x18,0x18,0x18, 0x18,0x18,0x18, 0x18,0x18,0x18, 0x18,0x18,0x18,
        0x38,0x18,0x1C, 0xF0,0xFF,0x0F, 0xC0,0xFF,0x03, 0x00,0x00,0x00
    },
    // 索引 9 : 数字 9
    {
        0x00,0x00,0x00, 0xC0,0x0F,0x03, 0xF0,0x0F,0x0F, 0x38,0x18,0x1C,
        0x18,0x18,0x18, 0x18,0x18,0x18, 0x18,0x18,0x18, 0x18,0x18,0x18,
        0x38,0x18,0x1C, 0xF0,0xFF,0x0F, 0xC0,0xFF,0x03, 0x00,0x00,0x00
    },
    // 索引 10 : 冒号 :
    {
        0x00,0x00,0x00, 0x00,0x00,0x00, 0x00,0x00,0x00, 0x00,0x00,0x00,
        0xC0,0xC7,0x07, 0xC0,0xC7,0x07, 0xC0,0xC7,0x07, 0xC0,0xC7,0x07,
        0x00,0x00,0x00, 0x00,0x00,0x00, 0x00,0x00,0x00, 0x00,0x00,0x00
    }
};

static uint8_t OLED_GRAM[8][128];

static void I2C_Write(uint8_t *d, uint16_t n) { HAL_I2C_Master_Transmit(&OLED_I2C, OLED_ADDR, d, n, 200); }
static void OLED_WriteCmd(uint8_t c) { uint8_t b[2]={0x00,c}; I2C_Write(b,2); }

void OLED_Init(void)
{
    HAL_Delay(100);
    uint8_t init[] = {
        0xAE, 0xD5,0x80, 0xA8,0x3F, 0xD3,0x00, 0x40,
        0x8D,0x14, 0x20,0x00, 0xA1, 0xC8,
        0xDA,0x12, 0x81,0xCF, 0xD9,0xF1, 0xDB,0x40,
        0xA4, 0xA6,
    };
    uint8_t buf[sizeof(init)+1]; buf[0]=0x00;
    memcpy(&buf[1], init, sizeof(init));
    I2C_Write(buf, sizeof(buf));
    OLED_Clear();
    OLED_WriteCmd(0xAF);
}

void OLED_SetContrast(uint8_t v) { OLED_WriteCmd(0x81); OLED_WriteCmd(v); }
void OLED_DisplayOn(void)  { OLED_WriteCmd(0xAF); }
void OLED_DisplayOff(void) { OLED_WriteCmd(0xAE); }

void OLED_SetPos(uint8_t x, uint8_t page)
{
    OLED_WriteCmd(0xB0 | (page & 0x07));
    OLED_WriteCmd(0x00 | (x & 0x0F));
    OLED_WriteCmd(0x10 | ((x >> 4) & 0x0F));
}

void OLED_Clear(void)
{
    uint8_t p;
    uint8_t buf[129]; buf[0] = 0x40;
    memset(&buf[1], 0, 128);
    for (p = 0; p < 8; p++) { OLED_SetPos(0, p); I2C_Write(buf, 129); }
}

void OLED_ClearBuffer(void) { memset(OLED_GRAM, 0, sizeof(OLED_GRAM)); }

void OLED_RefreshGram(void)
{
    uint8_t p;
    uint8_t buf[129]; buf[0] = 0x40;
    for (p = 0; p < 8; p++) {
        OLED_SetPos(0, p);
        memcpy(&buf[1], OLED_GRAM[p], 128);
        I2C_Write(buf, 129);
    }
}

void OLED_Display(void) { OLED_RefreshGram(); }

void OLED_DrawPoint(uint8_t x, uint8_t y, uint8_t c)
{
    if (x >= 128 || y >= 64) return;
    if (c) OLED_GRAM[y>>3][x] |=  (1 << (y & 7));
    else   OLED_GRAM[y>>3][x] &= ~(1 << (y & 7));
}

void OLED_Fill(uint8_t x1, uint8_t y1, uint8_t x2, uint8_t y2, uint8_t c)
{
    uint8_t x, y;
    for (x = x1; x <= x2; x++)
        for (y = y1; y <= y2; y++)
            OLED_DrawPoint(x, y, c);
}

void OLED_ShowChar(uint8_t x, uint8_t y, uint8_t chr, uint8_t size)
{
    uint8_t col, pg, cd;
    if (chr < 0x20 || chr > 0x7E) return;
    chr -= 0x20;
    pg = y >> 3;
    y = y & 0x07;
    for (col = 0; col < 6; col++) {
        if ((x + col) >= 128) break;
        cd = Font6x8[chr][col];
        if (y > 0) {
            OLED_GRAM[pg][x+col]   |= (cd << y);
            if (pg < 7) OLED_GRAM[pg+1][x+col] |= (cd >> (8-y));
        } else {
            OLED_GRAM[pg][x+col] |= cd;
        }
    }
}

void OLED_ShowString(uint8_t x, uint8_t y, const uint8_t *s, uint8_t size)
{
    while (*s) {
        if (x + 6 > 128) { x = 0; y += 10; }
        if (y + 8 > 64) break;
        OLED_ShowChar(x, y, *s, size);
        x += 7;
        s++;
    }
}

void OLED_ShowNum(uint8_t x, uint8_t y, uint32_t n, uint8_t len, uint8_t size)
{
    uint8_t i;
    for (i = 0; i < len; i++) {
        OLED_ShowChar(x + (len-1-i)*7, y, (n%10)+'0', size);
        n /= 10;
    }
}

void OLED_ShowFloat(uint8_t x, uint8_t y, float v, uint8_t il, uint8_t dl, uint8_t size)
{
    uint32_t ip = (uint32_t)v;
    uint32_t dp = (uint32_t)((v-ip)*(dl==2?100:10)+0.5f);
    uint8_t i;
    for (i=0;i<il;i++){OLED_ShowChar(x+(il-1-i)*7,y,(ip%10)+'0',size);ip/=10;}
    OLED_ShowChar(x+il*7,y,'.',size);
    for (i=0;i<dl;i++){OLED_ShowChar(x+(il+1+dl-1-i)*7,y,(dp%10)+'0',size);dp/=10;}
}

void OLED_DrawBMP(uint8_t x0,uint8_t y0,uint8_t x1,uint8_t y1,const uint8_t*b)
{
    uint8_t x,y; uint16_t w=x1-x0+1,bw=(w+7)/8;
    for(y=y0;y<=y1;y++)for(x=x0;x<=x1;x++)
        OLED_DrawPoint(x,y,(b[(y-y0)*bw+(x-x0)/8]>>(7-((x-x0)%8)))&1);
}

void OLED_ShowCN(uint8_t x,uint8_t y,uint8_t idx)
{
    (void)idx; uint8_t i;
    for(i=0;i<12&&x+i<128;i++){OLED_DrawPoint(x+i,y,1);OLED_DrawPoint(x+i,y+15,1);}
    for(i=0;i<16&&y+i<64;i++){OLED_DrawPoint(x,y+i,1);OLED_DrawPoint(x+11,y+i,1);}
}

void OLED_ShowLargeChar(uint8_t x, uint8_t y, uint8_t chr)
{
    uint8_t idx, col, pg, rowOff, b0, b1, b2;
    const uint8_t *glyph;
    if (chr >= '0' && chr <= '9') idx = chr - '0';
    else if (chr == ':') idx = 10;
    else return;
    glyph = Font12x24[idx];
    pg = y >> 3;
    rowOff = y & 0x07;
    for (col = 0; col < 12; col++) {
        if ((x + col) >= 128) break;
        b0 = glyph[col*3+0];
        b1 = glyph[col*3+1];
        b2 = glyph[col*3+2];
        if (rowOff == 0) {
            if (pg < 8)     OLED_GRAM[pg][x+col]   |= b0;
            if (pg+1 < 8)   OLED_GRAM[pg+1][x+col] |= b1;
            if (pg+2 < 8)   OLED_GRAM[pg+2][x+col] |= b2;
        } else {
            if (pg < 8)     OLED_GRAM[pg][x+col]   |= (b0 << rowOff);
            if (pg+1 < 8)   OLED_GRAM[pg+1][x+col] |= (b0 >> (8-rowOff)) | (b1 << rowOff);
            if (pg+2 < 8)   OLED_GRAM[pg+2][x+col] |= (b1 >> (8-rowOff)) | (b2 << rowOff);
            if (pg+3 < 8)   OLED_GRAM[pg+3][x+col] |= (b2 >> (8-rowOff));
        }
    }
}

void OLED_ShowLargeString(uint8_t x, uint8_t y, const uint8_t *str)
{
    while (*str) {
        uint8_t adv = (*str == ':') ? 10 : 12;
        if (x + adv > 128) break;
        OLED_ShowLargeChar(x, y, *str);
        x += adv;
        str++;
    }
}

void OLED_DrawHLine(uint8_t x, uint8_t y, uint8_t w, uint8_t color)
{
    uint8_t i;
    for (i = 0; i < w && (x+i) < 128; i++)
        OLED_DrawPoint(x+i, y, color);
}

void OLED_DrawVLine(uint8_t x, uint8_t y, uint8_t h, uint8_t color)
{
    uint8_t i;
    for (i = 0; i < h && (y+i) < 64; i++)
        OLED_DrawPoint(x, y+i, color);
}

void OLED_DrawFrame(uint8_t x, uint8_t y, uint8_t w, uint8_t h, uint8_t color)
{
    OLED_DrawHLine(x, y, w, color);
    OLED_DrawHLine(x, y+h-1, w, color);
    OLED_DrawVLine(x, y, h, color);
    OLED_DrawVLine(x+w-1, y, h, color);
}

void OLED_DrawDashedHLine(uint8_t x, uint8_t y, uint8_t w, uint8_t color)
{
    uint8_t i;
    for (i = 0; i < w && (x+i) < 128; i++)
        if ((i & 3) < 2) OLED_DrawPoint(x+i, y, color);
}
